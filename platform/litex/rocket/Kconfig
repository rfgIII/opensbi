## platform/litex/rocket/Kconfig
```kconfig
# SPDX-License-Identifier: BSD-2-Clause

config PLATFORM_ROCKET_LITEX
	bool
	select FDT
	select IPI_MSWI
	select IRQCHIP_PLIC
	select SERIAL_LITEX
	select TIMER_MTIMER
	default y
```
